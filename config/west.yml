## config/west.yml
```yaml
manifest:
  remotes:
    - name: zmkfirmware
      url-base: https://github.com/zmkfirmware
    - name: Xoffio
      url-base: https://github.com/Xoffio
  projects:
    - name: zmk
      remote: Xoffio
      revision: xo-status-fx
      import: app/west.yml
  self:
    path: config
```
